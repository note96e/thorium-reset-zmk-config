#include <dt-bindings/zmk/matrix_transform.h>
#include "thorium_reset-layouts.dtsi"

/ {
    chosen {
        zmk,physical-layout = &physical_layout0;
    };
    default_transform: keymap_transform_0 {
        compatible = "zmk,matrix-transform";
        columns = <5>;
        rows = <1>;
        map = <
            RC(0,0)	RC(0,1)	RC(0,2)	RC(0,3)	RC(0,4)
        >;
    };
};
