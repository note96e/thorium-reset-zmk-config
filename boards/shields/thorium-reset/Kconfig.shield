## boards/shields/thorium-reset/Kconfig.shield
```kconfig
config SHIELD_THORIUM_RESET_DONGLE
    def_bool $(shields_list_contains,thorium_reset_dongle)

config SHIELD_THORIUM_RESET_LEFT
    def_bool $(shields_list_contains,thorium_reset_left)

config SHIELD_THORIUM_RESET_RIGHT
    def_bool $(shields_list_contains,thorium_reset_right)
```

## config/boards/shields/thorium-reset/Kconfig.defconfig
```kconfig
if SHIELD_THORIUM_RESET

config ZMK_KEYBOARD_NAME
    default "ThoriumReset"

endif

if SHIELD_THORIUM_RESET_LEFT

config ZMK_KEYBOARD_NAME
    default "ThoriumResetL"

endif

if SHIELD_THORIUM_RESET_RIGHT

config ZMK_KEYBOARD_NAME
    default "ThoriumResetR"

endif
```

## config/boards/shields/thorium-reset/Kconfig.shield
```kconfig
config SHIELD_THORIUM_RESET
    def_bool $(shields_list_contains,thorium_reset)

config SHIELD_THORIUM_RESET_LEFT
    def_bool $(shields_list_contains,thorium_reset_left)

config SHIELD_THORIUM_RESET_RIGHT
    def_bool $(shields_list_contains,thorium_reset_right)
```
