#include "thorium_reset.dtsi"

&physical_layout0 {
    kscan = <&kscan0>;
    transform = <&default_transform>;
};

/ {
    kscan0: kscan {
        compatible = "zmk,kscan-gpio-matrix";
        label = "KSCAN";
        diode-direction = "col2row";
        col-gpios
            = <&xiao_d 10 GPIO_ACTIVE_HIGH>
            , <&xiao_d 9 GPIO_ACTIVE_HIGH>
            , <&xiao_d 8 GPIO_ACTIVE_HIGH>
            , <&xiao_d 6 GPIO_ACTIVE_HIGH>
            , <&xiao_d 7 GPIO_ACTIVE_HIGH>
            ;
        row-gpios
            = <&xiao_d 4 (GPIO_ACTIVE_HIGH | GPIO_PULL_DOWN)>
            ;
    };
};
