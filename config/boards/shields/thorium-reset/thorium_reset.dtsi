#include <dt-bindings/zmk/matrix_transform.h>
/ {
    chosen {
        zmk,kscan = &kscan0;
        zmk,matrix_transform = &default_transform;
    };
    default_transform: keymap_transform_0 {
        compatible = "zmk,matrix-transform";
        columns = <5>;
        rows = <4>;
        map = <
            RC(0,0)	RC(0,1)	RC(0,2)	RC(0,3)	RC(0,4)
        >;
    };
};
